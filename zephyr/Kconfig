## zephyr/Kconfig
```kconfig
config MAPCAN
	bool "CAN code generated by mapcan from a CAN map"
	select CAN
	help
	  Build the C code that mapcan_generate() writes from a YAML CAN map in the
	  application's CMakeLists.txt: pack and unpack of the frames, struct can_frame
	  conversion, acceptance filters and the TX schedule of a device. The code is
	  generated again when the map changes. Needs the mapcan command (pip install
	  mapcan) on the build host.
```
